# P10_356.0 register map
Vendor: Texas Instruments
Peripheral module from a debugger description file (folder MSP432).
Registers are 8-bit, access not given, no defined reset value unless marked. A register's access mark holds for its fields unless they carry their own. Offsets are as the file gives them; lines under a group give offsets from that group; [hi:lo] are bit positions; {n}, {i} and the like mark numbered series; 'fields as' and 'values as' point back to an identical list; <NAME> marks a mode.

## P10
0x81 P10IN — Port 10 Input
0x83 P10OUT — Port 10 Output
0x85 P10DIR — Port 10 Direction
0x87 P10REN — Port 10 Resistor Enable
0x89 P10DS — Port 10 Drive Strength
0x8B P10SEL0 — Port 10 Select 0
0x8D P10SEL1 — Port 10 Select 1
0x97 P10SELC — Port 10 Complement Select
0x99 P10IES — Port 10 Interrupt Edge Select
0x9B P10IE — Port 10 Interrupt Enable
0x9D P10IFG — Port 10 Interrupt Flag
0x9E P10IV 16-bit ro — Port 10 Interrupt Vector Register
  [4:0] P10IV — Port 10 interrupt vector value
    0=NONE (No interrupt pending); 2=P10IFG0 (Interrupt Source: Port 10.0 interrupt; Interrupt Flag: P10IFG0; Interrupt Priority: Highest); 4=P10IFG1 (Interrupt Source: Port 10.1 interrupt; Interrupt Flag: P10IFG1); 6=P10IFG2 (Interrupt Source: Port 10.2 interrupt; Interrupt Flag: P10IFG2); 8=P10IFG3 (Interrupt Source: Port 10.3 interrupt; Interrupt Flag: P10IFG3); 10=P10IFG4 (Interrupt Source: Port 10.4 interrupt; Interrupt Flag: P10IFG4); 12=P10IFG5 (Interrupt Source: Port 10.5 interrupt; Interrupt Flag: P10IFG5); 14=P10IFG6 (Interrupt Source: Port 10.6 interrupt; Interrupt Flag: P10IFG6); 16=P10IFG7 (Interrupt Source: Port 10.7 interrupt; Interrupt Flag: P10IFG7; Interrupt Priority: Lowest)
