# PB_356.0 register map
Vendor: Texas Instruments
Peripheral module from a debugger description file (folder MSP432).
Registers are 16-bit, access not given, no defined reset value unless marked. A register's access mark holds for its fields unless they carry their own. Offsets are as the file gives them; lines under a group give offsets from that group; [hi:lo] are bit positions; {n}, {i} and the like mark numbered series; 'fields as' and 'values as' point back to an identical list; <NAME> marks a mode.

## PB
0x20 PBIN — Port B Input
0x22 PBOUT — Port B Output
0x24 PBDIR — Port B Direction
0x26 PBREN — Port B Resistor Enable
0x28 PBDS — Port B Drive Strength
0x2A PBSEL0 — Port B Select 0
0x2C PBSEL1 — Port B Select 1
0x36 PBSELC — Port B Complement Select
0x38 PBIES — Port B Interrupt Edge Select
0x3A PBIE — Port B Interrupt Enable
0x3C PBIFG — Port B Interrupt Flag
