# PE_356.0 register map
Vendor: Texas Instruments
Peripheral module from a debugger description file (folder MSP432).
Registers are 16-bit, access not given, no defined reset value unless marked. A register's access mark holds for its fields unless they carry their own. Offsets are as the file gives them; lines under a group give offsets from that group; [hi:lo] are bit positions; {n}, {i} and the like mark numbered series; 'fields as' and 'values as' point back to an identical list; <NAME> marks a mode.

## PE
0x80 PEIN — Port E Input
0x82 PEOUT — Port E Output
0x84 PEDIR — Port E Direction
0x86 PEREN — Port E Resistor Enable
0x88 PEDS — Port E Drive Strength
0x8A PESEL0 — Port E Select 0
0x8C PESEL1 — Port E Select 1
0x96 PESELC — Port E Complement Select
0x98 PEIES — Port E Interrupt Edge Select
0x9A PEIE — Port E Interrupt Enable
0x9C PEIFG — Port E Interrupt Flag
