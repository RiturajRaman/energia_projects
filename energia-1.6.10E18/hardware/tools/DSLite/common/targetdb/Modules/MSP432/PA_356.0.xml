# PA_356.0 register map
Vendor: Texas Instruments
Peripheral module from a debugger description file (folder MSP432).
Registers are 16-bit, access not given, no defined reset value unless marked. A register's access mark holds for its fields unless they carry their own. Offsets are as the file gives them; lines under a group give offsets from that group; [hi:lo] are bit positions; {n}, {i} and the like mark numbered series; 'fields as' and 'values as' point back to an identical list; <NAME> marks a mode.

## PA
0x00 PAIN — Port A Input
0x02 PAOUT — Port A Output
0x04 PADIR — Port A Direction
0x06 PAREN — Port A Resistor Enable
0x08 PADS — Port A Drive Strength
0x0A PASEL0 — Port A Select 0
0x0C PASEL1 — Port A Select 1
0x16 PASELC — Port A Complement Select
0x18 PAIES — Port A Interrupt Edge Select
0x1A PAIE — Port A Interrupt Enable
0x1C PAIFG — Port A Interrupt Flag
